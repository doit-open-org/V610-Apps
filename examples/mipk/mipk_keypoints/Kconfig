## examples/mipk/mipk_keypoints/Kconfig
```kconfig
config MIPK_KEYPOINTS_LAYOUT
    string "Default .keypoints file, empty for none"
    default ""
    help
      Empty, and the sample marks every point where it lies in one colour,
      which needs to know nothing about the subject and so suits any keypoint
      model. Name a .keypoints file and it says which points to draw, in what
      colour and size, and which of them to join into a pose.

      The file also declares how many keypoints the model emits, so a
      different model needs a different file rather than a rebuild. The ones
      shipped beside the program are coco.keypoints for the default person
      model and any stock yolo*-pose, hand.keypoints for the MediaPipe hand
      cascade. --keypoints overrides this per run.

config MIPK_KEYPOINTS_MODEL_PATH
    string "Default video model path"
    default "./person_pose.mipk"

config MIPK_KEYPOINTS_HOST
    string "H264 UDP destination"
    default "192.168.137.1"

config MIPK_KEYPOINTS_PORT
    int "H264 UDP port"
    default 9000
    range 1 65535

config MIPK_KEYPOINTS_GOP
    int "H264 keyframe interval in frames"
    default 30
    range 1 600
    help
      One keyframe per second at 30 fps. A receiver cannot start decoding, or
      recover from loss, until the next keyframe arrives.

config MIPK_KEYPOINTS_REPORT_INTERVAL
    int "Result report interval"
    default 30
    range 1 1000000

config MIPK_KEYPOINTS_KEYPOINT_PERCENT
    int "Keypoint visibility needed to draw it (percent)"
    default 50
    range 0 100
    help
      The model scores every keypoint for whether it is visible. A limb is
      drawn only when both of its ends clear this, so a leg hidden behind the
      body is left out rather than drawn to a guessed position. A .keypoints
      file may set its own per point, and then this is only the fallback.

config MIPK_KEYPOINTS_DRAW_BOX
    bool "Draw the box around each subject"
    default n
    help
      The points alone show where the subject is. The box is useful while
      checking a model, because it shows the detection even when the
      keypoints are too uncertain to draw.
```

## examples/mipk/mipk_object_detection/Kconfig
```kconfig
config MIPK_OBJECT_DETECTION_MODEL_PATH
    string "Default video model path"
    default "./yolo11n.mipk"

config MIPK_OBJECT_DETECTION_HOST
    string "H264 UDP destination"
    default "192.168.137.1"

config MIPK_OBJECT_DETECTION_PORT
    int "H264 UDP port"
    default 9000
    range 1 65535

config MIPK_OBJECT_DETECTION_REPORT_INTERVAL
    int "Result report interval"
    default 30
    range 1 1000000
```

## examples/mipk/mipk_wake_word/Kconfig
```kconfig
config MIPK_WAKE_WORD_MODEL_PATH
    string "Default audio model path"
    default "./okay_nabu.mipk"

config MIPK_WAKE_WORD_HOST
    string "Opus UDP destination"
    default "192.168.137.1"

config MIPK_WAKE_WORD_PORT
    int "Opus UDP destination port"
    default 9001
    range 1 65535

config MIPK_WAKE_WORD_RX_PORT
    int "Opus UDP receive port"
    default 9001
    range 1 65535

config MIPK_WAKE_WORD_MIC_GAIN_DB
    int "Microphone input gain (dB)"
    default 50
    range -78 80

config MIPK_WAKE_WORD_MIC_CHANNEL
    int "Physical CODEC microphone channel (0=ADCL, 1=ADCR)"
    default 0
    range 0 1

config MIPK_WAKE_WORD_ENABLE_AEC
    bool "Enable TalkV2 acoustic echo cancellation"
    default y

config MIPK_WAKE_WORD_OPUS_BIT_RATE
    int "Opus bit rate (bps)"
    default 32000
```

## examples/mipk/mipk_wake_word/sdkconfig.defaults
```kconfig
CONFIG_MIPK_AUDIO=y
CONFIG_MIPK_MODEL_MICROWAKEWORD=y
CONFIG_MIPK_WAKE_WORD_MODEL_PATH="./okay_nabu.mipk"
CONFIG_MIPK_WAKE_WORD_HOST="192.168.137.1"
CONFIG_MIPK_WAKE_WORD_PORT=9001
CONFIG_MIPK_WAKE_WORD_RX_PORT=9001
CONFIG_MIPK_WAKE_WORD_MIC_GAIN_DB=50
CONFIG_MIPK_WAKE_WORD_MIC_CHANNEL=0
CONFIG_MIPK_WAKE_WORD_ENABLE_AEC=y
CONFIG_MIPK_WAKE_WORD_OPUS_BIT_RATE=32000
```

## projects/llm/needle_control/Kconfig
```kconfig
config NEEDLE_CONTROL_MODEL_PATH
    string "Needle 3 model path"
    default "./needle3-l8.cact"
    help
      An 8 layer slice of needle3.cact, made by tools/prepare_model.sh.

config NEEDLE_CONTROL_TOOLS_PATH
    string "Tool schema path"
    default "./tools.json"

config NEEDLE_CONTROL_HTTP_PORT
    int "HTTP port, 0 to disable"
    default 8080
    range 0 65535
    help
      Requests are POST /command with a JSON body {"text": "..."}.

config NEEDLE_CONTROL_MAX_TOKENS
    int "Most tokens generated per request"
    default 64
    range 16 512
```

## projects/vision/hand_gimbal/Kconfig
```kconfig
config HAND_GIMBAL_MODEL_PATH
    string "Model package path"
    default "./mediapipe_hand.mipk"

config HAND_GIMBAL_RTSP_PORT
    int "RTSP port"
    default 8554
    range 1 65535
    help
      The annotated video is served at rtsp://<board>:<port>/live.

config HAND_GIMBAL_GOP
    int "H264 keyframe interval in frames"
    default 30
    range 1 600

config HAND_GIMBAL_REPORT_INTERVAL
    int "State report interval in frames"
    default 30
    range 1 1000000

config HAND_GIMBAL_CLOSE_PERCENT
    int "Pinch close threshold (percent of palm width)"
    default 45
    range 1 400
    help
      Thumb tip to index tip distance, as a percentage of the index-to-pinky
      knuckle span, below which the fingers count as touching.

config HAND_GIMBAL_OPEN_PERCENT
    int "Pinch release threshold (percent of palm width)"
    default 70
    range 1 400
    help
      The same ratio above which the pinch is released. Must exceed the close
      threshold; the gap between them is the hysteresis band.

config HAND_GIMBAL_EXTENSION_PERCENT
    int "Required finger extension (percent of palm length)"
    default 110
    range 1 400
    help
      Shortest of the middle, ring and pinky reach from the wrist, over the
      wrist-to-middle-knuckle length. A closed fist stays below this, which is
      what separates a pinch from a fist.

config HAND_GIMBAL_STRAIGHT_PERCENT
    int "Required finger straightness (percent)"
    default 85
    range 1 100
    help
      Knuckle to tip over the length of the finger walked joint by joint,
      taking the least straight of the middle, ring and pinky. This rejects a
      pinch made with the other fingers curled. Run with --trace to see what
      a real hand measures.

config HAND_GIMBAL_CONFIRM_FRAMES
    int "Frames required to change pinch state"
    default 2
    range 1 60

config HAND_GIMBAL_PINCH_FRAMES
    int "Frames a pinch must hold before the mount follows"
    default 5
    range 1 60
    depends on SERVO_TRACKER
    help
      The skeleton turns red as soon as the pinch is confirmed; only the
      servos wait this long, so a pinch made in passing never moves the
      mount. Letting go releases the mount at once.
```
